## Firmware/boards/shields/zboard_v1/Kconfig.zboard_v1
```kconfig
config BOARD_TOFU65
    select SOC_RP2040
    imply RETAINED_MEM
    imply RETENTION
    imply RETENTION_BOOT_MODE
```

## Firmware/old/boards/shields/zboard_v1/Kconfig.defconfig
```kconfig
if SHIELD_ZBOARD_V1

config ZMK_KEYBOARD_NAME
    default "ZBoard-V1"

endif # SHIELD_ZBOARD_V1
```
